// Copyright 2021 Manna Harbour
// https://github.com/manna-harbour/miryoku

#include "./miryoku-base/custom_config.h"
#include "./miryoku-base/mapping/42/corne.h"
#include "./miryoku-base/miryoku.dtsi"